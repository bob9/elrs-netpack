## components/espnow_server/Kconfig.projbuild
```kconfig
menu "ESPNOW Server options"
    config ESPNOW_MAX_SEND_ATTEMPTS
        int "Number of ESPNOW send attempts"
        default 5
        help
            The number of retries when sending an
            ESPNOW message

    config ESPNOW_SEND_DELAY
        int "Delay (ms) before each ESPNOW retry attempt"
        default 25
        help
            Milliseconds to wait before each RETRY of an unacked
            ESPNOW frame. Spacing retries decorrelates them from
            bursty 2.4GHz interference (e.g. the pilots' ELRS RC
            links at race start). No delay is added before the
            first attempt, so acked frames see zero added latency.

    config ESPNOW_HIGH_RATE
        bool "Send ESPNOW frames at 24Mbps instead of the 1Mbps default"
        default y
        help
            Shortens each frame's airtime ~15x so OSD traffic can slot
            into the gaps of the pilots' 2.4GHz RC-link schedule at race
            start, at the cost of some receive-sensitivity margin.
            Disable if goggles at the far end of a large venue stop
            receiving messages.

    config ESPNOW_CHANNEL
        int "Channel"
        default 1
        range 0 14
        help
            The channel on which sending and receiving ESPNOW data.
endmenu
```

## components/ota_server/Kconfig.projbuild
```kconfig
menu "ELRS Netpack OTA Server Configuration"

    config OTA_SERVER_PORT
        int "OTA web server port"
        default 80
        help
            TCP port for the firmware update web page and OTA upload endpoint.

endmenu
```

## components/tcp_server/Kconfig.projbuild
```kconfig
menu "TCP Socket Server options"
    config TCP_SERVER_PORT
        int "TCP server listening port"
        default 8080
        help
            Set TCP server listening port.

    config USE_STATIC_IP
        bool "Use a static IP address (recommended) instead of DHCP"
        default y
        help
            Network mode baked into the firmware. Static IP is the supported
            default: the timing computer / dd-pits agent must always find the
            netpack at a fixed, known address. Disable ONLY to build a DHCP
            firmware for setups where the router pins the address by MAC
            reservation. In static builds the address (not the mode) can be
            changed at runtime without reflashing via the USB serial console
            'netconfig static <ip>' command (stored in NVS, overrides the
            defaults below).

    config STATIC_IP_ADDR
        string "Default static IP address"
        default "192.168.1.195"
        help
            Static IP address for the ethernet interface (e.g., 192.168.1.100).
            Only used when static IP mode is active and no address has been set
            via the 'netconfig' serial console command.

    config STATIC_NETMASK
        string "Default static netmask"
        default "255.255.255.0"
        help
            Netmask for the static IP configuration (e.g., 255.255.255.0).

    config STATIC_GATEWAY
        string "Default static gateway"
        default "192.168.1.1"
        help
            Gateway IP address for the static IP configuration (e.g., 192.168.1.1).

endmenu
```

## sdkconfig.defaults
```kconfig
# Common project configuration shared by every board.
# Board selection lives in sdkconfig.board.<board-slug>; build with e.g.
#   idf.py -DSDKCONFIG_DEFAULTS="sdkconfig.defaults;sdkconfig.board.waveshare-esp32-s3-eth" set-target esp32s3 build
CONFIG_COMPILER_ORPHAN_SECTIONS_PLACE=y
# Two-slot OTA layout for network firmware updates; the CSV (sized to the
# board's flash) is chosen in sdkconfig.board.<board-slug>
CONFIG_PARTITION_TABLE_CUSTOM=y
CONFIG_HTTPD_MAX_REQ_HDR_LEN=512
CONFIG_LOG_COLORS=y
CONFIG_LWIP_LOCAL_HOSTNAME="elrs-netpack"
CONFIG_LWIP_DNS_SUPPORT_MDNS_QUERIES=n
CONFIG_LWIP_DHCPS=n
CONFIG_LWIP_HOOK_IP6_INPUT_NONE=y
CONFIG_MBEDTLS_ECP_FIXED_POINT_OPTIM=y
CONFIG_MDNS_MAX_INTERFACES=1
# One service for the MSP socket (_elrs-backpack), one for the update page (_http)
CONFIG_MDNS_MAX_SERVICES=2
CONFIG_MDNS_ENABLE_CONSOLE_CLI=n
CONFIG_MDNS_RESPOND_REVERSE_QUERIES=y
CONFIG_MDNS_MULTIPLE_INSTANCE=n
CONFIG_MDNS_PREDEF_NETIF_STA=n
CONFIG_MDNS_PREDEF_NETIF_AP=n
CONFIG_MDNS_PREDEF_NETIF_ETH=n
```
